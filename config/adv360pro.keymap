/* source keypos definitions */
#include "../zmk-nodefree-config/keypos_def/keypos_adv360.h"

/* map 360's extra keys */
#define X_LT    &kp GRAVE &kp N1 &kp N2 &kp N3 &kp N4 &kp N5 &none     &none &kp N6 &kp N7 &kp N8 &kp N9 &kp N0 &kp EQUAL \
                &kp TAB
#define X_MT    &none &none
#define X_RT    &kp SLASH

#define X_LM    &kp ESC
#define X_MM    &none &none
#define X_RM    &kp MINUS

#define X_LB    &kp LSHFT
#define X_RB    &kp RSHFT

#define X_LH    &none &kp BACKSLASH &kp CAPS &kp LEFT &kp RIGHT     &kp UP &kp DOWN &kp LBKT &kp RBKT &none \
                &kp LCTRL &kp LALT      &kp LGUI  &kp RCTRL
#define X_MH    &kp HOME    &kp PG_UP
#define X_RH    &kp END     &kp PG_DN

/* activate bluetooth */
#define CONFIG_WIRELESS 1

/* leds and backlights */
#include <dt-bindings/zmk/rgb.h>
#include <dt-bindings/zmk/backlight.h>

/* source the main keymap */
#include "base.keymap"

/* use urob's layout for Advantage 360 pro */
/ { chosen { zmk,matrix_transform = &urobs_transform; }; };

